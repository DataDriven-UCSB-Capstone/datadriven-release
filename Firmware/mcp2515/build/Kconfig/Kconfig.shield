## Firmware/mcp2515/build/Kconfig/Kconfig.shield
```kconfig
osource "/home/ubuntu/GitHub/mcp2515_shield/boards/shields/*/Kconfig.shield"
osource "/home/ubuntu/Downloads/capstone/can/boards/shields/*/Kconfig.shield"
osource "/home/ubuntu/ncs/v2.1.2/nrf/boards/shields/*/Kconfig.shield"
```

## Firmware/tracker/boards/arm/datadriven/Kconfig.board
```kconfig
# nRF9160 DK NRF9160 board configuration

# Copyright (c) 2018-2020 Nordic Semiconductor ASA
# SPDX-License-Identifier: Apache-2.0

if SOC_NRF9160_SICA

config BOARD_DATADRIVEN
	bool "DataDriven"

config BOARD_DATADRIVEN_NS
	bool "DataDriven non-secure"

endif # SOC_NRF9160_SICA
```

## PCB/device_tests/simple/can_obd/Kconfig
```kconfig
# Private config options for can sample app

# Copyright (c) 2018 Alexander Wachter
# SPDX-License-Identifier: Apache-2.0

mainmenu "Controller Area Network sample application"

source "Kconfig.zephyr"
```
