## prj.conf
```kconfig
CONFIG_NRF_MODEM_LIB=y
CONFIG_NRF_MODEM_LIB_SYS_INIT=y
CONFIG_NEWLIB_LIBC=y

CONFIG_SPI=y
CONFIG_CAN=y
CONFIG_CAN_MCP2515=y
CONFIG_CAN_INIT_PRIORITY=80
CONFIG_CAN_MAX_FILTER=5

CONFIG_AT_MONITOR=y
CONFIG_SHELL=y
CONFIG_CAN_SHELL=y
CONFIG_DEVICE_SHELL=y
CONFIG_SHELL_ARGC_MAX=13
CONFIG_LOG=y

CONFIG_GPIO=y
```

## src/main.c
```c
/*
 * Copyright (c) 2021 Nordic Semiconductor ASA
 *
 * SPDX-License-Identifier: LicenseRef-Nordic-5-Clause
 */

#include <string.h>
#include <zephyr/kernel.h>
#include <nrf_modem_at.h>

void main(void)
{
	
	char response[64];
	int err;
	err = nrf_modem_at_cmd(response, sizeof(response), "AT+CGSN");
	if (err) {
		printk("Failed to read IMEI, err %d\n", err);
		return;
	}

	char IMEI[16];

	strncpy(IMEI, response, 15);
	IMEI[15] = '\0';

	printk("IMEI: %s\n", IMEI);

	err = nrf_modem_at_cmd(response, sizeof(response), "AT+CIMI");
	if (err) {
		printk("Failed to read IMSI, err %d\n", err);
		return;
	}

	printk("IMSI: %s\n", response);
}
```
